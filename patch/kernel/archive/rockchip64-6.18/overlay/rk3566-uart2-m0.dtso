/dts-v1/;
/plugin/;

/ {
	fragment@0 {
		target = <&uart2>;

		__overlay__ {
			status = "okay";
			pinctrl-0 = <&uart2m0_xfer>;
		};
	};

	fragment@1 {
		target-path = "/chosen";
		__overlay__ {
			bootargs = "earlycon=uart8250,mmio32,0xfe660000 console=ttyFIQ0";
		};
	};
};
